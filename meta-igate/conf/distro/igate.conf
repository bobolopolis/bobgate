## meta-igate/conf/distro/igate.conf
```bitbake
DISTRO = "igate"
DISTRO_NAME = "igate (APRS IGate)"
DISTRO_VERSION = "0.0.0"
DISTRO_CODENAME = "bobstone"
SDK_VENDOR = "-igatesdk"
SDK_VERSION = "${@d.getVar('DISTRO_VERSION').replace('snapshot-${METADATA_REVISION}', 'snapshot')}"
SDK_VERSION[vardepvalue] = "${SDK_VERSION}"

MAINTAINER = "Robert Joslyn <robert.joslyn@redrectangle.org>"

TARGET_VENDOR = "-igate"

LOCALCONF_VERSION = "2"

DISTRO_FEATURES ?= " \
    acl \
    alsa \
    argp \
    bluetooth \
    debuginfod \
    ext2 \
    ipv4 \
    ipv6 \
    largefile \
    multiarch \
    pci \
    seccomp \
    systemd \
    usbgadget \
    usbhost \
    vfat \
    wifi \
    xattr \
    zeroconf \
"
INIT_MANAGER = "systemd"
PREFERRED_VERSION_linux-bob ?= "5.15%"

PACKAGE_CLASSES = "package_rpm"

INITRAMFS_IMAGE = "igate-initramfs"
INITRAMFS_FSTYPES = "cpio.xz"

SDK_NAME = "${DISTRO}-${TCLIBC}-${SDKMACHINE}-${IMAGE_BASENAME}-${TUNE_PKGARCH}-${MACHINE}"
SDKPATHINSTALL = "/opt/${DISTRO}/${SDK_VERSION}"

DISTRO_EXTRA_RDEPENDS += "packagegroup-core-boot"
DISTRO_EXTRA_RRECOMMENDS += "kernel-module-af-packet"

TCLIBCAPPEND = ""

SANITY_TESTED_DISTROS ?= " \
            poky-3.3 \n \
            poky-3.4 \n \
            ubuntu-16.04 \n \
            ubuntu-18.04 \n \
            ubuntu-20.04 \n \
            ubuntu-21.10 \n \
            ubuntu-22.04 \n \
            fedora-34 \n \
            fedora-35 \n \
            centos-7 \n \
            centos-8 \n \
            debian-9 \n \
            debian-10 \n \
            debian-11 \n \
            opensuseleap-15.3 \n \
            almalinux-8.5 \n \
            "
# add poky sanity bbclass
INHERIT += "poky-sanity"

# QA check settings - a little stricter than the OE-Core defaults
# (none currently necessary as we now match OE-Core)
#WARN_TO_ERROR_QA = "X"
#WARN_QA_remove = "${WARN_TO_ERROR_QA}"
#ERROR_QA_append = " ${WARN_TO_ERROR_QA}"

require conf/distro/include/poky-world-exclude.inc
require conf/distro/include/no-static-libs.inc
require conf/distro/include/yocto-uninative.inc
require conf/distro/include/security_flags.inc
INHERIT += "uninative"

BB_SIGNATURE_HANDLER ?= "OEEquivHash"
BB_HASHSERVE ??= "auto"
```

## meta-igate/conf/layer.conf
```bitbake
BBPATH .= ":${LAYERDIR}"
BBFILES += "${LAYERDIR}/recipes-*/*/*.bb ${LAYERDIR}/recipes-*/*/*.bbappend"

BBFILE_COLLECTIONS += "igate"
BBFILE_PATTERN_igate = "^${LAYERDIR}/*"
BBFILE_PRIORITY_igate = "6"

LAYERDEPENDS_igate = "core openembedded-layer"
LAYERSERIES_COMPAT_igate = "kirkstone"
```
